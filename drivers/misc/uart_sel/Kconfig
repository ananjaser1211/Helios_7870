## drivers/soc/samsung/Kconfig
```kconfig
#
# EXYNOS Soc drivers
#
menuconfig SOC_SAMSUNG
	bool "SAMSUNG SOC drivers support"

if SOC_SAMSUNG
config EXYNOS_CHIPID
	bool "Exynos Chip ID Driver Support"
	depends on ARCH_EXYNOS
	select SOC_BUS
config EXYNOS_REBOOT
	bool "Exynos Chip Reboot Driver Support"
	depends on ARCH_EXYNOS

config SAMSUNG_DMADEV
	bool
	select ARM_AMBA
	select DMADEVICES
	select PL330_DMA if (ARCH_EXYNOS7 || ARCH_EXYNOS8)
	help
	  Use DMA device engine for PL330 DMAC.

config SAMSUNG_CORE_TEST
	bool "Show system-control registers"
	depends on ARCH_EXYNOS
	help
	  Show system-control registers.

config ECT
	bool "Enable Exynos Characteristic Table File"
	default n
	depends on ARCH_EXYNOS

config ECT_DUMP
	bool "Enable Exynos Characteristic Table File Dump sysfs"
	default n
	depends on ECT

config EXYNOS_CONTENT_PATH_PROTECTION
	bool "Exynos Content Path Protection"
	default y
	help
	  Enable content path protection of EXYNOS.

config SCHED_AVG_NR_RUNNING
	bool "Enable to use average nr_running"
	default n
	help
	  Enable to use average nr_running in scheduler

config EXYNOS_HOTPLUG_GOVERNOR
	bool "Enable Exynos dynamic hotplug governor"
	select SCHED_AVG_NR_RUNNING

config EXYNOS_MCINFO
	bool "Exynos memory controller information"
	default n

config MCINFO_SYSFS
	bool "Exynos memory controller information sysfs"
	depends on EXYNOS_MCINFO
	default	y if SYSFS

endif #SOC_SAMSUNG

config SEC_INCELL
	bool "Incell data & function for Samsung"
	default n
	help
	  say y to enable incell data & function for Samsung.
```

## drivers/staging/samsung/Kconfig
```kconfig
# drivers/staging/samsung/Kconfig
#
# Copyright (c) 2010-2011 Samsung Electronics Co., Ltd.
#		http://www.samsung.com/
#
# Licensed under GPLv2

comment "Samsung TN Features"
menuconfig SEC_EXT
	bool "Samsung TN extension features"
	default y

config SEC_SYSFS
	bool "Create a sysfs node for SEC_CLASS"
	depends on SEC_EXT
	default y

config SEC_REBOOT
	bool "Enable TN reboot features"
	depends on SEC_EXT
	default y

menuconfig SEC_DEBUG
	bool "Enable TN debugging features"
	depends on EXYNOS_SNAPSHOT && SEC_REBOOT
	default y

config SEC_DEBUG_RESET_REASON
	bool "Enable TN reset reason"
	depends on SEC_DEBUG
	default y
	help
	  This option enables storing reset reason history file
	  This option enables reading the reset reason history using proc/reset_reason file

config SEC_DEBUG_EXTRA_INFO
	bool "Enable TN reset reason extra info"
	depends on SEC_DEBUG && SEC_DEBUG_RESET_REASON
	default n
	help
	  This option enables storing reset reason extra info
	  This option enables ap reset info bigdata based on reset reason extra info

config SEC_DEBUG_HW_PARAM
	bool "Enable TN HW PARAM bigdata info"
	depends on SEC_DEBUG && SEC_DEBUG_RESET_REASON
	default n
	help
	  This option enables storing hw param bigdata info

config SEC_DEBUG_AUTO_SUMMARY
	bool "Enable TN kernel fault auto summary"
	depends on SEC_DEBUG
	default n
	help
	  This option enables kernel fault auto summary feature
	  This option also requires bootloader change that enables auto summary extraction along with ramdump

config SEC_DEBUG_LAST_KMSG
	bool "Write last_kmsg at /proc/last_kmsg"
	depends on SEC_DEBUG
	default y
	help
	  This option enables /proc/last_kmsg support.

config SEC_DEBUG_FILE_LEAK
	bool "Panic when file leak detected"
	depends on !SAMSUNG_PRODUCT_SHIP
	default y

config SEC_UPLOAD
	bool "Enable TN upload mode"
	depends on SEC_DEBUG
	default y
	help
	  Samsung TN upload mode

config SEC_HW_REV
	bool "Get GPIO HW REV"
	depends on SEC_DEBUG
	default n


config SEC_DEBUG_MDM_SEPERATE_CRASH
	bool "Enable modem crash with a seperated command"
	depends on SEC_DEBUG
	default n
	help
	  This option enables modem crash other debug level.

comment "Samsung TN BSP Options"
config SEC_PARAM
	bool "Enable Param modification"
	depends on SEC_DEBUG
	default n
	help
	  Samsung TN Param Feature.

config SEC_BOOTSTAT
	bool "Enable TN Bootstat logging"
	depends on SEC_EXT
	default y

config SEC_INITCALL_DEBUG
	bool "Enable Initcall Debug Feature"
	default n
	depends on SEC_EXT && !SAMSUNG_PRODUCT_SHIP
	help
	  Enable Samsung initcall debug support.

config ARGOS
	bool "Throughput monitoring Feature"
	default n
	help
	  Check throughput and set appropriate system parameters(CPU freq, affinity, etc)

comment "Samsung TN Logging Options"
config SEC_AVC_LOG
	default n
	bool "Enable avc audit log support" if EMBEDDED
	depends on SEC_EXT
	help
	  This option enables additional log buffer for audit log.

config SEC_DEBUG_TSP_LOG
	default n
	bool "Enable tsp log support" if EMBEDDED
	depends on SEC_EXT
	help
	  This option enables additional log buffer for tsp log.

config SEC_DEBUG_PMIC
	default n
	bool "Enable pmic debug option support" if EMBEDDED
	depends on SEC_EXT
	help
	  This option enables additional debug option for pmic.
	  Enable this option for eng build only.

comment "Samsung TN Power Management Options"
menuconfig SEC_PM
	bool "Samsung TN Power Management"
	default y
	help
	  Samsung TN Power Management.

config SEC_PM_DEBUG
	bool "Enable Samsung TN Power management debug support"
	default y
	depends on SEC_PM
	help
	  Enable Samsung TN Power management debug support.

config SEC_EVENT_LOG
	bool "Enable Event log parser"
	depends on SEC_EXT
	default y

comment "Samsung TN NAD Options"
config SEC_NAD
	bool "Samsung TN NAD Feature"
	default n
	help

	  Samsung TN NAD Feature, support AT CMD for NAD 2.0
	  	  
config SEC_NAD_MANUAL_PARAM_READTIME
	int "Samsung TN NAD Feature"
	depends on SEC_NAD
	default "10"
	help
	  Samsung TN NAD Feature, set param reading time manually.

config SEC_NAD_API
	bool "Samsung TN NAD API Feature"
	depends on SEC_NAD
	default n
	help
	  Samsung TN NAD Feature, Support NAD API to check gpio pull-up registance

choice
	prompt "Version of GAF structure"
	depends on SEC_DEBUG
	default SEC_DEBUG_GAF_V4 if FIVE
	default SEC_DEBUG_GAF_V3

	config SEC_DEBUG_GAF_V3
		bool "Use GAF structure version 3"
		help
		  Default option for FIVE-disabled kernel

	config SEC_DEBUG_GAF_V4
		bool "Use GAF structure version 4"
		help
		  Default option for FIVE-enabled kernel
endchoice
```

## drivers/video/fbdev/exynos/decon_7870/Kconfig
```kconfig
config EXYNOS_DECON_7870
	bool "Samsung Exynos7870 Display system (DECON, MIPI)"
	depends on FB

choice
	prompt "Select Display Operation Mode"
	depends on EXYNOS_DECON_7870
	default EXYNOS7870_DISPLAY_VIDEO_MODE
	help
	  Select the display operation mode (Command/Video).

config EXYNOS7870_DISPLAY_COMMAND_MODE
	bool "Command Mode"

config EXYNOS7870_DISPLAY_VIDEO_MODE
	bool "Video Mode"

endchoice

choice
	prompt "Select TE IRQ Mode"
	depends on EXYNOS_DECON_7870 && EXYNOS7870_DISPLAY_COMMAND_MODE
	default EXYNOS7870_DISPLAY_TE_IRQ_GPIO
	help
	  Select the TE IRQ mode.

config EXYNOS7870_DISPLAY_TE_IRQ_GPIO
	bool "Dual GPIO"

config EXYNOS7870_DISPLAY_TE_IRQ_GIC
	bool "GIC Interrupt"

endchoice

config USE_VSYNC_SKIP
   bool "Vsync Skip Enable"
   depends on EXYNOS_DECON_7870
   default n
   help
     Say Y here if you want to enable vsync skip feature for DFS solution.

config EXYNOS_DECON_FB
	bool "Samsung DECON Framebuffer driver"
	depends on EXYNOS_DECON_7870
	select MEDIA_EXYNOS
	default y
	help
	  Say Y here if you want support for the DECON in Samsung S5P SoCs.
	  This device produce image data to one of output interfaces.

config EXYNOS_MIPI_DSI
	bool "Samsung Exynos MIPI-DSI driver"
	depends on EXYNOS_DECON_7870
	default y
	help
	  Enable MIPI-DSI driver.

config DECON_MIPI_DSI_PKTGO
	bool "Samsung Exynos MIPI-DSI Packet Go"
	depends on EXYNOS_DECON_7870 && EXYNOS_MIPI_DSI
	default n
	help
	  Enable/disable MIPI-DSI Packet Go function

config DECON_LPD_DISPLAY
        bool "Decon Low Power Display MODE"
        depends on EXYNOS_DECON_7870
        depends on EXYNOS7870_DISPLAY_COMMAND_MODE
        default n

config DECON_LPD_DISPLAY_WITH_CAMERA
        bool "Decon Low Power Display MODE with Camera"
        depends on DECON_LPD_DISPLAY
        depends on EXYNOS7870_DISPLAY_COMMAND_MODE

config DECON_DEVFREQ
	bool "Decon devfreq implementation"
	depends on EXYNOS_DECON_7870

config FB_WINDOW_UPDATE
        bool "DECON window update mode"
        depends on EXYNOS_DECON_7870
        depends on EXYNOS7870_DISPLAY_COMMAND_MODE
        default n

config DECON_BLOCKING_MODE
	bool "DECON blocking mode"
        depends on EXYNOS_DECON_7870
        default n

config DECON_USE_BOOTLOADER_FB
	bool "DECON Bootloader Framebuffer support"
        depends on EXYNOS7870_DISPLAY_VIDEO_MODE
        default n

config DECON_EVENT_LOG
	bool "Display sub-system event logger (DECON/DSIM)"
        depends on DEBUG_INFO && EXYNOS_DECON_7870
        default y

config EXYNOS_MIPI_DSI_ENABLE_EARLY
	bool "Samsung Exynos MIPI-DSI Driver ENABLE EARLY"
	default n

source "drivers/video/fbdev/exynos/decon_7870/panels/Kconfig"
```

## drivers/video/fbdev/exynos/decon_7870/panels/Kconfig
```kconfig
config EXYNOS_DECON_LCD
	depends on EXYNOS_DECON_7870
	bool "Select LCD panel driver"

config EXYNOS_DECON_LCD_SYSFS
	depends on EXYNOS_DECON_LCD
	bool "Support LCD SYSFS"
	default y

config PANEL_AID_DIMMING
	depends on EXYNOS_DECON_LCD
	bool "Support AID Dimming"
	default n

config EXYNOS_DECON_MDNIE_LITE
	depends on EXYNOS_DECON_LCD
	bool "Support MDNIE LITE"
	default n

config LCD_DOZE_MODE
	depends on EXYNOS_DECON_LCD
	bool "Support DOZE MODE"
	default n

config DISPLAY_USE_INFO
	depends on EXYNOS_DECON_LCD
	bool "Support display use info logging"
	default n

config PANEL_EA8064G_DYNAMIC
	depends on EXYNOS_DECON_LCD && EXYNOS_MIPI_DSI
	bool "EA8064G Amoled FHD driver"

config PANEL_S6E3FA3_J7XE
	depends on EXYNOS_DECON_LCD && EXYNOS_MIPI_DSI
	bool "S6E3FA3 J7XE LCD driver"

config PANEL_EA8061S_J7XE
	depends on EXYNOS_DECON_LCD && EXYNOS_MIPI_DSI
	bool "EA8061S Amoled driver"

config PANEL_LTL101AL06
	depends on EXYNOS_DECON_LCD && EXYNOS_MIPI_DSI
	bool "LTL101AL06 TFT HD driver(1280 x 800)"

config EXYNOS_LCD_PWM_BACKLIGHT
	depends on PANEL_LTL101AL06
	bool "EXYNOS_LCD_PWM_BACKLIGHT"

config PANEL_S6D7AA0
	depends on EXYNOS_DECON_LCD && EXYNOS_MIPI_DSI
	bool "S6D7AA0 TFT HD driver"

config PANEL_HX8279D
	depends on EXYNOS_DECON_LCD && EXYNOS_MIPI_DSI
	bool "HX8279D TFT WUXGA driver(1200 x 1920)"

config PANEL_S6D7AA0_BV055HDM
	depends on EXYNOS_DECON_LCD && EXYNOS_MIPI_DSI
	bool "S6D7AA0_ON7E TFT HD driver"

config PANEL_S6E3AA2_AMS474KF09
	depends on EXYNOS_DECON_LCD && EXYNOS_MIPI_DSI
	bool "S6E3AA2 Amoled driver"

config PANEL_TD4300
	depends on EXYNOS_DECON_LCD && EXYNOS_MIPI_DSI
	bool "TD4300 TFT WUXGA driver"

config PANEL_BRIGHTNESS_MAX_480CD
	depends on PANEL_TD4300
	bool "Panel backlight brightness max is 480CD"

config PANEL_S6E3AA2_A3Y17
	depends on EXYNOS_DECON_LCD && EXYNOS_MIPI_DSI
	bool "S6E3AA2_A3Y17 Amoled HD driver(WITH AOD)"

config PANEL_S6E8AA5X01
	depends on EXYNOS_DECON_LCD && EXYNOS_MIPI_DSI
	bool "S6E8AA5X01 AMOLED HD LCD driver"

config PANEL_S6E8AA5X01_J5Y17_KOR
	depends on PANEL_S6E8AA5X01
	bool "S6E8AA5X01 AMOLED HD LCD driver"

config PANEL_TD4100_J7POP
	depends on EXYNOS_DECON_LCD && EXYNOS_MIPI_DSI
	bool "TD4100 TFT HD driver"

config PANEL_S6E3FA3_J7Y17
	depends on EXYNOS_DECON_LCD && EXYNOS_MIPI_DSI
	bool "S6E3FA3 J7Y17 LCD driver"

config PANEL_EA8061S_J7VE
	depends on EXYNOS_DECON_LCD && EXYNOS_MIPI_DSI
	bool "EA8061S Amoled driver"

config PANEL_S6D7AA0_GTACTIVE2
	depends on EXYNOS_DECON_LCD && EXYNOS_MIPI_DSI
	bool "S6D7AA0 TFT LCD driver"

config PANEL_S6D78A0_GPPIRIS
	depends on EXYNOS_DECON_LCD && EXYNOS_MIPI_DSI
	bool "S6D78A0 TFT LCD driver"

config PANEL_S6D7AT0B_J7TOP
	depends on EXYNOS_DECON_LCD && EXYNOS_MIPI_DSI
	bool "S6D7AT0B TFT LCD driver"

config PANEL_S6E8AA5X01_A6LTE
	depends on EXYNOS_DECON_LCD && EXYNOS_MIPI_DSI
	bool "S6E8AA5X01 driver"

config PANEL_S6E8AA5X01_J6Y18
	depends on EXYNOS_DECON_LCD && EXYNOS_MIPI_DSI
	bool "S6E8AA5X01 driver"
```

## drivers/video/fbdev/exynos/decon_8890/panels/Kconfig
```kconfig
config EXYNOS_DECON_LCD
	depends on EXYNOS_DECON_8890
	bool "Select LCD panel driver"

config EXYNOS_DECON_LCD_S6E3HA2K
	depends on EXYNOS_DECON_LCD && EXYNOS_MIPI_DSI
	tristate "S6E3HA2K AMOLED WQHD LCD driver(1440 x 2560)"
```

## security/tz_iccc/Kconfig
```kconfig
#
# TZ iccc configuration
#
config TZ_ICCC
	bool "TZ ICCC"
	depends on TIMA && !SEC_FACTORY
	default n
	---help---
	Provide kernel api for reading and writing ICCC secure parameters.
```
