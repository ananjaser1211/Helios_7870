/*
 * SAMSUNG UNIVERSAL5433 board device tree source
 *
 * Copyright (c) 2013 Samsung Electronics Co., Ltd.
 *		http://www.samsung.com
 *
 * This program is free software; you can redistribute it and/or modify
 * it under the terms of the GNU General Public License version 2 as
 * published by the Free Software Foundation.
*/

#include "exynos7870-j7popelte-common-battery.dtsi"
/ {

	battery_params {
		battery,id = <0>;
		battery0,battery_type = <4400>; /* 4200 4350 4400 */
		battery0,battery_table0 = <0x1400 0x1B5C 0x1C81 0x1D6E 0x1D87 0x1DE1 0x1E46 0x1EA6 0x1EFE 0x1F66 0x1FF5 0x206C 0x2097 0x215C 0x2247 0x2400>;
		battery0,battery_table1 = <0x1400 0x1B5C 0x1C81 0x1D6E 0x1D87 0x1DE1 0x1E46 0x1EA6 0x1EFE 0x1F66 0x1FF5 0x206C 0x2097 0x215C 0x2247 0x2400>;
		battery0,battery_table2 = <0x0000 0x003F 0x0082 0x0144 0x0289 0x0470 0x083E 0x0C0D 0x0DF4 0x0F38 0x11C2 0x1307 0x13A9 0x1632 0x1934 0x1948>;
		battery0,temp_std = <25>;
		battery0,temp_offset = <10>;
		battery0,temp_offset_cal = <0x01>;
		battery0,rce_value = <0x0749 0x0580 0x371>;
		battery0,dtcd_value = <0x1>;
		battery0,rs_value = <0x1ae 0x47a 0x3800 0x00a4>; /*rs mix_factor max min*/
		battery0,vit_period = <0x3506>;
		battery0,mix_value = <0x0403 0x0004>; /*mix_rate init_blank*/
		battery0,topoff_soc = <0x0 0x5>; /*enable soc*/
		battery0,tem_poff = <3400 100 3320 100>;
		battery0,charge_offset_cal = <0x03>;
		battery0,volt_cal = <0x808A>;
		battery0,curr_cal = <0x7785>;
		battery0,ext_temp_cal = <0 10 1 1 1 7 1 1>;
	};
};
