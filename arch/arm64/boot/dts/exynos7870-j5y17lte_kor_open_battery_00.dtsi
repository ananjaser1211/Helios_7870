/*
 * SAMSUNG UNIVERSAL5433 board device tree source
 *
 * Copyright (c) 2013 Samsung Electronics Co., Ltd.
 *		http://www.samsung.com
 *
 * This program is free software; you can redistribute it and/or modify
 * it under the terms of the GNU General Public License version 2 as
 * published by the Free Software Foundation.
*/

#include "exynos7870-j5y17lte_common_battery.dtsi"
/ {

	battery_params {
			battery,battery_table1 = <188 11 61 11 191 10 64 10 196 9
					75 9 217 8 110 8 13 8 173 7
					66 7 235 6 177 6 132 6 96 6
					67 6 31 6 242 5 164 5 124 5
					23 5 144 1 216 8 105 8 251 7
					141 7 30 7 176 6 65 6 211 5
					101 5 246 4 136 4 25 4 171 3
					60 3 206 2 95 2 241 1 131 1
					20 1 166 0 55 0 201 15>;

			battery,battery_table2 = <50 50 50 50 50 50 51 51 51 52
					52 53 53 54 54 55 55 56 57 59
					63 154>;

			battery,battery_table3 = <204 11 61 11 174 10 34 10 169 9
					55 9 206 8 107 8 230 7 166 7
					77 7 234 6 174 6 130 6 95 6
					67 6 36 6 253 5 197 5 147 5
					42 5 168 1 215 8 105 8 252 7
					142 7 33 7 179 6 69 6 215 5
					106 5 252 4 143 4 33 4 179 3
					69 3 216 2 106 2 252 1 143 1
					33 1 179 0 70 0 216 15>;

			battery,battery_table4 = <62 62 61 60 61 60 59 60 60 58
					58 58 58 58 58 58 59 60 62 64
					76 148>;

			battery,batcap = <0x2D 0xF0 0x0B 0x7C>; /* [0x0F] [0x0E] [0x11] [0x10] */

			battery,soc_arr_evt1 = <10515 10000 9485 8969 8453 7937 7421 6905 6389 5873 5358 4842 4326 3810 3294 2778 2263 1747 1231 716 200 (-269)>;
			battery,ocv_arr_evt1 = <44051 43459 42867 42288 41716 41175 40664 40199 39779 39268 38784 38482 38250 38059 37906 37778 37594 37368 36957 36835 36289 31955>;

			
			battery,soc_arr_evt2 = <11051 10515 9980 9444 8909 8373 7838 7302 6766 6231 5696 5160 4625 4089 3554 3018 2482 1947 1411 876 340 (-195)>;
			battery,ocv_arr_evt2 = <44748 44050 43352 42664 42077 41519 41006 40522 39872 39562 39127 38645 38349 38135 37966 37827 37676 37485 37211 36970 36453 32069>;
			
			battery,FG_Accumulative_rate_evt2 = <0xC2 0x07>;
	};
};
