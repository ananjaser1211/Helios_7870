/*
 * SAMSUNG EXYNOS device tree source for reserved-memory
 *
 * Copyright (c) 2015 Samsung Electronics Co., Ltd.
 *		http://www.samsung.com
 *
 * This program is free software; you can redistribute it and/or modify
 * it under the terms of the GNU General Public License version 2 as
 * published by the Free Software Foundation.
*/

#include "exynos7870-rmem-2000MB.dtsi"

/ {
	reserved-memory {
		secure_camera {
			compatible = "exynos8890-ion,secure_camera";
			secure;
			reg = <0x0 0x89000000 0x1D00000>;
			id = <11>;
		};
	};
};
