## arch/arm64/configs/treble_defconfig
```kconfig
#
#
# Treble defconfig
#
# CONFIG_USB_ANDROID_SAMSUNG_MTP is not set
CONFIG_NETFILTER_XT_TARGET_CT=y
# CONFIG_EXFAT_FS is not set
CONFIG_FAT_DEFAULT_IOCHARSET="utf8"
CONFIG_SDFAT_SUPPORT_DIR_SYNC=y
CONFIG_SDFAT_CHECK_RO_ATTR=y
# CONFIG_NLS_CODEPAGE_437 is not set
# CONFIG_NLS_ISO8859_1 is not set
# CONFIG_NLS_UTF8 is not set
```

## arch/arm64/mach-exynos/Kconfig
```kconfig
# arch/arm64/mach-exynos/Kconfig
#
# Copyright (c) 2016 Samsung Electronics Co., Ltd.
#		http://www.samsung.com/
#
# Licensed under GPLv2

# Configuration options for the EXYNOS7

if ARCH_EXYNOS

menu "SAMSUNG EXYNOS SoCs Support"

config SKIP_HW_BREAKPOINT
	bool "support skip hw breakpoint"
	default n
	help
	  Support early param for T32 onchip breakpoint

config SEC_BAT_AUT
	bool "Samsung TN Bat Automation Test Feature"
	default n
	help
	  Samsung TN Bat Automation Test

config SAMSUNG_PRODUCT_SHIP
	bool "set up for product shipping"
	default n

config BOARD_J5Y17LTE
	bool "Samsung Galaxy J5 2017 (J530X)
	default n

config BOARD_J7Y17LTE
	bool "Samsung Galaxy J7 2017 (J730X)
	default n

config BOARD_J7XELTE
	bool "Samsung Galaxy J7 2016 (J710X)
	default n

config BOARD_J7VELTE
	bool "Samsung Galaxy J7 2016 NXT (J701X)
	default n

config BOARD_ON7XELTE
	bool "Samsung Galaxy J7 Prime (G610X)
	default n

config BOARD_J6LTE
	bool "Samsung Galaxy J6 2018 (J600X)
	default n

config BOARD_A6LTE
	bool "Samsung Galaxy A6 2018 (A600X)
	default n

endmenu

endif
```
