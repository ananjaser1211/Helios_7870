## drivers/media/platform/exynos/fimc-is2/sensor/module_framework/cis/Kconfig
```kconfig
menuconfig CAMERA_CIS_SELECT
	bool "Sensor cis select"
	depends on USE_DIRECT_IS_CONTROL
	help
	  Say Y here to enable support for platform-specific V4L drivers.

config CAMERA_CIS_6B2_OBJ
	bool "Use 6B2 camera cis"
	depends on USE_DIRECT_IS_CONTROL
	depends on CAMERA_CIS_SELECT
	default n
	help
	  Use to build 6B2 camera sensor.

config CAMERA_CIS_5E2_OBJ
	bool "Use 5E2 camera cis"
	depends on USE_DIRECT_IS_CONTROL
	depends on CAMERA_CIS_SELECT
	default n
	help
	  Use to build 5E2 camera sensor.

config CAMERA_CIS_5E3_OBJ
	bool "Use 5E3 camera cis"
	depends on USE_DIRECT_IS_CONTROL
	depends on CAMERA_CIS_SELECT
	default n
	help
	  Use to build 5E3 camera sensor.

config CAMERA_CIS_5E6_OBJ
	bool "Use 5E6 camera cis"
	depends on USE_DIRECT_IS_CONTROL
	depends on CAMERA_CIS_SELECT
	default n
	help
	  Use to build 5E6 camera sensor.

config CAMERA_CIS_5F1_OBJ
	bool "Use 5F1 camera cis"
	depends on USE_DIRECT_IS_CONTROL
	depends on CAMERA_CIS_SELECT
	default n
	help
	  Use to build 5F1 camera sensor.

config CAMERA_CIS_4H5YC_OBJ
	bool "Use 4H5YC camera cis"
	depends on USE_DIRECT_IS_CONTROL
	depends on CAMERA_CIS_SELECT
	default n
	help
	  Use to build 4H5YC camera sensor.

config CAMERA_CIS_4H5_OBJ
	bool "Use 4H5 camera cis"
	depends on USE_DIRECT_IS_CONTROL
	depends on CAMERA_CIS_SELECT
	default n
	help
	  Use to build 4H5 camera sensor.

config CAMERA_CIS_2P2_OBJ
	bool "Use 2P2 camera cis"
	depends on USE_DIRECT_IS_CONTROL
	depends on CAMERA_CIS_SELECT
	default n
	help
	  Use to build 2P2 camera sensor.

config CAMERA_CIS_2P6_OBJ
	bool "Use 2P6 camera cis"
	depends on USE_DIRECT_IS_CONTROL
	depends on CAMERA_CIS_SELECT
	default n
	help
	  Use to build 2P6 camera sensor.

config CAMERA_CIS_2P8_OBJ
	bool "Use 2P8 camera cis"
	depends on USE_DIRECT_IS_CONTROL
	depends on CAMERA_CIS_SELECT
	default n
	help
	  Use to build 2P8 camera sensor.

config CAMERA_CIS_3P3_OBJ
	bool "Use 3P3 camera cis"
	depends on USE_DIRECT_IS_CONTROL
	depends on CAMERA_CIS_SELECT
	default n
	help
	  Use to build 3P3 camera sensor.

config CAMERA_CIS_3P8_OBJ
	bool "Use 3P8 camera cis"
	depends on USE_DIRECT_IS_CONTROL
	depends on CAMERA_CIS_SELECT
	default n
	help
	  Use to build 3P8 camera sensor.

config CAMERA_CIS_3L2_OBJ
	bool "Use 3L2 camera cis"
	depends on USE_DIRECT_IS_CONTROL
	depends on CAMERA_CIS_SELECT
	default n
	help
	  Use to build 3L2 camera sensor.

config CAMERA_CIS_3L6_OBJ
	bool "Use 3L6 camera cis"
	depends on USE_DIRECT_IS_CONTROL
	depends on CAMERA_CIS_SELECT
	default n
	help
	  Use to build 3L6 camera sensor.

config CAMERA_CIS_3M3_OBJ
	bool "Use 3M3 camera cis"
	depends on USE_DIRECT_IS_CONTROL
	depends on CAMERA_CIS_SELECT
	default n
	help
	  Use to build 3M3 camera sensor.

config CAMERA_CIS_SR544_OBJ
	bool "Use SR544 camera cis"
	depends on USE_DIRECT_IS_CONTROL
	depends on CAMERA_CIS_SELECT
	default n
	help
	  Use to build SR544 camera sensor.

config CAMERA_CIS_SR259_OBJ
	bool "Use SR259 camera cis"
	depends on USE_DIRECT_IS_CONTROL
	depends on CAMERA_CIS_SELECT
	default n
	help
	  Use to build SR259 camera sensor.

config CAMERA_CIS_IMX258_OBJ
	bool "Use IMX258 camera cis"
	depends on USE_DIRECT_IS_CONTROL
	depends on CAMERA_CIS_SELECT
	default n
	help
	  Use to build IMX258 camera sensor.

config CAMERA_CIS_IMX219_OBJ
	bool "Use IMX219 camera cis"
	depends on USE_DIRECT_IS_CONTROL
	depends on CAMERA_CIS_SELECT
	default n
	help
	  Use to build IMX219 camera sensor.
```

## drivers/media/platform/exynos/fimc-is2/vendor/mcd/Kconfig
```kconfig
config CAMERA_EEPROM_SUPPORT_REAR
        bool "Enable eeprom for rear cam"
        depends on VENDER_MCD
        default n
        help
          Enable eeprom for rear cam.
config CAMERA_EEPROM_SUPPORT_REAR3
        bool "Enable eeprom for rear3 cam"
        depends on VENDER_MCD
        default n
        help
          Enable eeprom for rear2 cam.
config CAMERA_EEPROM_SUPPORT_FRONT
        bool "Enable eeprom for front cam"
        depends on VENDER_MCD
        default n
        help
          Enable eeprom for front cam.
config CAMERA_EEPROM_SUPPORT_OIS
        bool "Enable eeprom for ois"
        depends on VENDER_MCD
        default n
        help
          Enable eeprom for ois cam.
config CAMERA_OTPROM_SUPPORT_REAR
        bool "Enable otprom for rear cam"
        depends on VENDER_MCD
        default n
        help
          Enable otprom for rear cam.
config CAMERA_OTPROM_SUPPORT_FRONT
        bool "Enable otprom for front cam"
        depends on VENDER_MCD
        default n
        help
          Enable otprom for front cam.
config COMPANION_USE
        bool "Use companion"
        depends on VENDER_MCD
        default n
        help
          Use companion.
 config COMPANION_C1_USE
        bool "Use companion C1"
        depends on VENDER_MCD
        default n
        help
          Use companion C1.
 config COMPANION_C2_USE
        bool "Use companion C2"
        depends on VENDER_MCD
        default n
        help
          Use companion C2.
 config CONFIG_DEVICE_COMPANION_C2_USE
        bool "Use device companion C2"
        depends on VENDER_MCD
        default n
        help
          Use device companion C2.
 config COMPANION_C3_USE
        bool "Use companion C3"
        depends on VENDER_MCD
        default n
        help
          Use companion C3.
config COMPANION_DCDC_USE
        bool "Use companion DCDC regulator"
        depends on VENDER_MCD
        default n
        help
          Use companion DCDC regulator.
config PREPROCESSOR_STANDBY_USE
        bool "Use companion standby"
        depends on VENDER_MCD
        default n
        help
          Use companion standby.
config OIS_USE
        bool "Use ois"
        depends on VENDER_MCD
        default n
        help
          Use ois.
config OIS_USE_BU24219
        bool "Use ois BU24219"
        depends on VENDER_MCD
        default n
        help
          Use ois BU24219.
config OIS_FW_UPDATE_THREAD_USE
        bool "Enable ois fw update thread"
        depends on OIS_USE
        default n
        help
          Enable ois fw update thread.
config AF_HOST_CONTROL
        bool "Enable host af control"
        depends on VENDER_MCD
        default n
        help
          Enable host af control.
config TORCH_CURRENT_CHANGE_SUPPORT
        bool "Change torch current in recording mode"
        depends on VENDER_MCD
        default n
        help
          Change torch current in recording mode.
config SECURE_CAMERA_USE
        bool "Use secure camera"
        depends on VENDER_MCD
        default n
        help
          Use secure camera.
config CAMERA_JOSHUA
        bool "This camera is joshua project"
        depends on VENDER_MCD
        default n
        help
          This camera is joshua project.
config CAMERA_MATISSE10
        bool "This camera is matisse10 project"
        depends on VENDER_MCD
        default n
        help
          This camera is matisse10 project.
config CAMERA_J7X
        bool "This camera is j7x project"
        depends on VENDER_MCD
        default n
        help
          This camera is j7x project.
config CAMERA_GTAXL
        bool "This camera is gtaxl project"
        depends on VENDER_MCD
        default n
        help
          This camera is gtaxl project.
config CAMERA_A7MAX
        bool "This camera is a7max project"
        depends on VENDER_MCD
        default n
        help
          This camera is a7max project.
config CAMERA_ON7E
        bool "This camera is on7e project"
        depends on VENDER_MCD
        default n
        help
          This camera is on7e project.
config CAMERA_ON7X
        bool "This camera is on7x project"
        depends on VENDER_MCD
        default n
        help
          This camera is on7x project.
config CAMERA_A3XPREMIUM
        bool "This camera is a3xpremium project"
        depends on VENDER_MCD
        default n
        help
          This camera is a3xpremium project.
config CAMERA_A3Y17
        bool "This camera is a3y17 project"
        depends on VENDER_MCD
        default n
        help
          This camera is a3y17 project.
config CAMERA_J5Y17
        bool "This camera is j5y17 project"
        depends on VENDER_MCD
        default n
        help
          This camera is j5y17 project.
config CAMERA_J7Y17
        bool "This camera is j7y17 project"
        depends on VENDER_MCD
        default n
        help
          This camera is j7y17 project.
config CAMERA_J7POPKOR
        bool "This camera is j7popkor project"
        depends on VENDER_MCD
        default n
        help
          This camera is j7popkor project.
config CAMERA_J7POP
        bool "This camera is j7pop project"
        depends on VENDER_MCD
        default n
        help
          This camera is j7pop project.
config CAMERA_J7VE
        bool "This camera is j7ve project"
        depends on VENDER_MCD
        default n
        help
          This camera is j7ve project.
config CAMERA_GTACTIVE2
        bool "This camera is gtactive2 project"
        depends on VENDER_MCD
        default n
        help
          This camera is gtactive2 project.
config CAMERA_GRANDPPIRIS
        bool "This camera is grandppiris project"
        depends on VENDER_MCD
        default n
        help
          This camera is grandppiris project.
config CAMERA_ON7XREF
        bool "This camera is on7xref project"
        depends on VENDER_MCD
        default n
        help
          This camera is on7xref project.
config CAMERA_J7TOP
        bool "This camera is j7top project"
        depends on VENDER_MCD
        default n
        help
          This camera is j7top project.
config CAMERA_DEGASY18
        bool "This camera is degasy18 project"
        depends on VENDER_MCD
        default n
        help
          This camera is degasy18 project.
config CAMERA_J8
        bool "This camera is j8 project"
        depends on VENDER_MCD
        default n
        help
          This camera is j8 project.
config CAMERA_GTAXLAD
        bool "This camera is gtaxlad project"
        depends on VENDER_MCD
        default n
        help
          This camera is gtaxlad project.
config CAMERA_J6
        bool "This camera is j6 project"
        depends on VENDER_MCD
        default n
        help
          This camera is j6 project.
config CAMERA_A6
        bool "This camera is a6 project"
        depends on VENDER_MCD
        default n
        help
          This camera is a6 project.
config CAMERA_J7VEIRIS
        bool "This camera is J7veiris project"
        depends on VENDER_MCD
        default n
        help
          This camera is J7veiris project.
config CAMERA_M10LTE
        bool "This camera is M10 project"
        depends on VENDER_MCD
        default n
        help
          This camera is M10 project.
config CAMERA_A2CORELTE
        bool "This camera is A2CORE project"
        depends on VENDER_MCD
        default n
        help
          This camera is A2CORE project.		  
config CAMERA_5E6_USE_1P2_POWER
        bool "5E6 sensor use 1p2 power pin"
        depends on VENDER_MCD
        default n
        help
          5E6 sensor use 1p2 power pin.
```

## drivers/media/platform/exynos/fimg2d_v5/Kconfig
```kconfig
#
# Copyright (c) 2015 Samsung Electronics Co., Ltd.
#		http://www.samsung.com/
#
# Licensed under GPLv2

config VIDEO_EXYNOS_FIMG2D_V5
	bool "Samsung Graphics 2D Driver v5"
	depends on VIDEO_EXYNOS && ARCH_EXYNOS8
	default n
	---help---
	  This is a legacy driver for graphics 2D in Samsung ARM based SoC.

config FIMG2D_CCI_SNOOP
	bool "Enables CCI snoop control"
	depends on VIDEO_EXYNOS_FIMG2D_V5
	default n
	---help---
	  This enables a CCI snoop control for cache coherency.
```

## drivers/media/radio/si47xx/Kconfig
```kconfig
config FM_SI47XX
	tristate "si47XX FM radio"
	default n
	help
	  Say Y to supprot Si47XX FM radio.

config FM_SI47XX_RDS_INT_ON_ALWAYS
	tristate "si47XX FM radio"
	depends on FM_SI47XX
	default n
	help
	  Say Y to support Si47XX FM RDS INTERRUT ON ALWAYS.
```

## drivers/misc/bhy/Kconfig
```kconfig
#
# Makefile for Bosch sensors driver.
#
config SENSORS_BHI
	tristate "BHI sensor hub driver support"
	default n
	depends on I2C
	help
	  If you say yes here, you get support for Bosch Sensortec's
	  BHI sensor hub driver.

config SENSORS_BHI_BMP280
	tristate "BHI sensor hub include BMP280 pressure sensor"
	default n
	depends on SENSORS_BHI
	help
	  If you say yes here, you get support for Bosch Sensortec's
	  BHI sensor hub driver with BMP280 pressure sensor.
```

## drivers/misc/gnss_if/Kconfig
```kconfig
config GNSS_SHMEM_IF
	bool "Samsung Shared memory Interface for GNSS"
	depends on MCU_IPC
	default n
	---help---
	  Samsung Shared Memory Interface for GNSS.

config GNSS_DISABLE
	bool "Disable GNSS for WIFI only model"
	depends on GNSS_SHMEM_IF
	default n
	---help---
	  Disable GNSS for WIFI only model(Hibernation mode)
```
