## drivers/bts/Kconfig
```kconfig
#
# BTS driver configuration
#

menuconfig EXYNOS_BTS
	bool "BTS driver support"
	default y
	help
	  Enable BTS (Bus traffic shaper) support

if EXYNOS_BTS

config EXYNOS8890_BTS
	bool "Bus traffic shaper support"
	default y
	depends on SOC_EXYNOS8890
	help
	  Enable BTS (Bus traffic shaper) support

config EXYNOS7870_BTS
	bool "Bus traffic shaper support"
	default y
	depends on SOC_EXYNOS7870
	help
	  Enable BTS (Bus traffic shaper) support
endif
```

## drivers/ccic/Kconfig
```kconfig
#
# USB PD driver
#

comment "USB PD configs"

config USE_CCIC
	bool "Using USBPD device driver"
	depends on I2C
	default n
	help
	  If you say yes here you will get support for
	  the USB PD(Power Delivery) device driver.

config CCIC_S2MU004
	bool "Using S2MU004 USB PD"
	depends on USE_CCIC
	default n
	help
	  If you say yes here you will get support for
	  for the S2MU004 USBPD chip.

config CCIC_S2MM005 
	bool "CCIC S2MM005"
	depends on I2C 
	default n
	help
	  If you say yes here you will get support for
	  s2mm005 ccic full version chipset 
	  
config CCIC_NOTIFIER
	bool "CCIC notifier support"
	depends on I2C
	default n
	help
	  If you say yes here you will get support for
	  the CCIC attached device status change notification.

config CCIC_ALTERNATE_MODE 
	bool "support CCIC alternate mode"
	depends on I2C
	default n
	help
	  If you say yes here you will get support for
	  alternate mode

config CCIC_LPM_ENABLE
	bool "Support LPM ENABLE"
	depends on CCIC_S2MM005
	default n
	help
	  If you say yes here you will get support for
	  lpm enable

config CCIC_WATER_DETECT
	bool "support WATER DETECT"
	depends on CCIC_S2MM005
	default n
	help
	  If you say yes here you will get support for
	  water detect Enable
```

## drivers/gpu/arm/t83x/Kconfig
```kconfig
#
# (C) COPYRIGHT 2012-2013 ARM Limited. All rights reserved.
#
# This program is free software and is provided to you under the terms of the
# GNU General Public License version 2 as published by the Free Software
# Foundation, and any use by you of this program is subject to the terms
# of such GNU licence.
#
# A copy of the licence is included with the program, and can also be obtained
# from Free Software Foundation, Inc., 51 Franklin Street, Fifth Floor,
# Boston, MA  02110-1301, USA.
#
#


config DDK_VERSION_OS
	string "version"
	default ANDROID_MAJOR_VERSION
	help
	  Android OS major version

menuconfig MALI_T83X
	tristate "Mali-T83X support"
	default y
	help
	  Enable this option to build support for the ARM Mali-T83X GPU.
	  To compile this driver as a module, choose M here:
	  this will generate a single module, called mali_kbase.

choice
	prompt "version Configuration"
	depends on MALI_T83X
	default MALI_R12P0 if DDK_VERSION_OS = "m"
	default MALI_R15P0 if DDK_VERSION_OS = "n"
	default MALI_R22P0 if DDK_VERSION_OS = "o"
	default MALI_R28P0 if DDK_VERSION_OS = "p"
	default MALI_R29P0 if DDK_VERSION_OS = "q"
	help
	  Select the gpu support version.

config MALI_R12P0
	depends on MALI_T83X
	bool "r12p0 driver"

config MALI_R15P0
	depends on MALI_T83X
	bool "r15p0 driver"

config MALI_R21P0
	depends on MALI_T83X
	bool "r21p0 driver"

config MALI_R22P0
	depends on MALI_T83X
	bool "r22p0 driver"

config MALI_R28P0
	depends on MALI_T83X
	bool "r28p0 driver"
	
config MALI_R29P0
	depends on MALI_T83X
	bool "r29p0 driver"
endchoice

if MALI_R12P0
source "drivers/gpu/arm/t83x/r12p0/Kconfig"
endif

if MALI_R15P0
source "drivers/gpu/arm/t83x/r15p0/Kconfig"
endif

if MALI_R21P0
source "drivers/gpu/arm/t83x/r21p0/Kconfig"
endif

if MALI_R22P0
source "drivers/gpu/arm/t83x/r22p0/Kconfig"
endif

if MALI_R28P0
source "drivers/gpu/arm/t83x/r28p0/Kconfig"
endif

if MALI_R29P0
source "drivers/gpu/arm/t83x/r29p0/Kconfig"
endif
```

## drivers/gud/Kconfig
```kconfig
#
# Mobicore Configuration
#

if SOC_EXYNOS8890
source "drivers/gud/gud-exynos8890/Kconfig"
endif

if SOC_EXYNOS7870
source "drivers/gud/gud-exynos7870/Kconfig"
endif
```

## drivers/ifpmic/Kconfig
```kconfig
#
# IFPMIC device configuration
#

#modified by khoonk 2018.01.03
config MFD_S2MU004
	bool "SAMSUNG Electronics IF PMIC S2MU004 Series Support"
	depends on I2C=y
	select MFD_CORE
	help
	 Support for the Samsung Electronics MFD series.
	 This driver provides common support for accessing the device,
	 additional drivers must be enabled in order to use the functionality
	 of the device

menuconfig IFPMIC_SUPPORT
	bool "IFPMIC support"
	depends on I2C
	default n
	---help---
	  This option adds core support for Interface Periperal Management Interface IC (IFPMIC).
	  You will also need drivers from the following menu to make use of it.

source "drivers/ifpmic/muic/Kconfig"

config PDIC
	tristate "Support for CC & PD driver"
	depends on I2C
	default n
	---help---
	  PDIC driver is a specification of Type C USB CC & PD

source "drivers/ifpmic/battery_v2/Kconfig"

source "drivers/ifpmic/manager/Kconfig"

#source "drivers/ifpmic/pdic/Kconfig"

#source "drivers/ifpmic/led/Kconfig"

#source "drivers/ifpmic/motor/Kconfig"

#config CHARGER
#	tristate "Support for Charger driver"
#	depends on I2C
#	default y
#	---help---
#	  Charger driver
#
#source "drivers/ifpmic/charger/Kconfig"

#config FUELGAUGE
#	tristate "Support for Fuelgauge driver"
#	depends on I2C
#	default y
#	---help---
#	  Fuelgauge driver
#
#source "drivers/ifpmic/fuelgauge/Kconfig"
```

## drivers/ifpmic/muic/Kconfig
```kconfig
#
# MUIC devices
#

comment "MUIC configs"

config USE_MUIC
	bool "Using MUIC device driver"
	depends on I2C
	default n
	help
	  If you say yes here you will get support for
	  the MUIC device driver.

config MUIC_NOTIFIER
	bool "MUIC notifier support"
	depends on USE_MUIC
	default n
	help
	  If you say yes here you will get support for
	  the MUIC attached device status change notification.

config MUIC_SUPPORT_CCIC
	bool "MUIC supports CCIC chip interface"
	depends on USE_MUIC
	default n
	help
	  If you say yes here you will get support for the CCIC chip.

config MUIC_S2MU004
	bool "Using S2MU004 MUIC"
	depends on USE_MUIC && MFD_S2MU004
	default n
	help
	  If you say yes here you will get support for
	  for the S2MU004 MUIC chip.

config MUIC_S2MU004_NON_USB_C_TYPE
	bool "Using S2MU005 MUIC with non usb-c type"
	depends on MUIC_S2MU004
	default n
	help
	  If you say yes here you will get support for
	  for the S2MU004 MUIC non usb-c type chip.

config HV_MUIC_S2MU004_AFC
	bool "Using S2MU005 MUIC AFC"
	depends on MUIC_S2MU004
	default n
	help
	  If you say yes here you will get support for
	  for the S2MU004 MUIC AFC chip.

config HV_MUIC_VOLTAGE_CTRL
	bool "Using AFC voltage control functionality"
	depends on HV_MUIC_S2MU004_AFC
	default n
	help
	  If you say yes here you will get support for
	  for the AFC voltage control functionality.

config NEW_SEC_FACTORY
	bool "Using NEW SEC FACTORY"
	depends on USE_MUIC
	default n
	help
		If you say yes here you will get support for
		for the NEW SEC FACTORY feature.

config MUIC_MANAGER
	bool "MUIC Manager supports CCIC chip interface"
	depends on USE_MUIC && MFD_S2MU004
	default n
	help
		If you say yes here you will get support manager for the CCIC chip.

config MUIC_VOLTAGE_CTRL
	bool "Using AFC Voltage control functionality"
	depends on MUIC_S2MU004_AFC
	default n
	help
		If you say yes here you will get support for
		the AFC voltage control functionality.

config HICCUP_CHARGER
	bool "Using HICCUP charger"
	depends on USE_MUIC
	default n
	help
		If you say yes here you will get support for
		for the hiccup charger feature.
```

## drivers/iio/magnetometer/yas537/Kconfig
```kconfig
#
# Magnetometer sensors
#

config SENSORS_YAS_INPUT_MAGNETOMETER
	tristate "Yamaha 3-Axis Magnetometer"
	depends on IIO
	help
	  Say Y here to add support for the Yamaha 3-Axis Magnetometer.
```

## drivers/input/keyboard/melfas_mip4/Kconfig
```kconfig
#
# Kconfig for MELFAS MIP4 Touchkey Driver
#

if INPUT_KEYBOARD

config KEYBOARD_MELFAS_MHS204
        tristate "MELFAS MHS204 Touchkey"
        depends on I2C
        help
          Say Y here if you have a MELFAS MHS204 Touchkey device in your system.

          If unsure, say N.

          To compile this driver as a module, choose M here: the module will be called mip4_tk.
          
config KEYBOARD_MELFAS_MHS204G
        tristate "MELFAS MHS204G Touchkey"
        depends on I2C
        help
          Say Y here if you have a MELFAS MHS204G Touchkey device in your system.

          If unsure, say N.

          To compile this driver as a module, choose M here: the module will be called mip4_tk.

config KEYBOARD_MELFAS_MHS2041
        tristate "MELFAS MHS2041 Touchkey"
        depends on I2C
        help
          Say Y here if you have a MELFAS MHS2041 Touchkey device in your system.

          If unsure, say N.

          To compile this driver as a module, choose M here: the module will be called mip4_tk.

        
config KEYBOARD_MELFAS_MHS2041B
        tristate "MELFAS MHS2041B Touchkey"
        depends on I2C
        help
          Say Y here if you have a MELFAS MHS2041B Touchkey device in your system.

          If unsure, say N.

          To compile this driver as a module, choose M here: the module will be called mip4_tk.
                  
endif
```

## drivers/input/touchscreen/synaptics_dsx_2.6/Kconfig
```kconfig
#
# Synaptics DSX v2.6 touchscreen driver configuration
#
config TOUCHSCREEN_SYNAPTICS_DSX_v26
	tristate "Synaptics DSX i2c touchscreen"
	depends on I2C
	help
	  This enables support for Synaptics DSX over I2C based touchscreens.
```

## drivers/input/touchscreen/synaptics_td4x00/Kconfig
```kconfig
#
# SYNAPTICS TOUCH driver configuration
#

config TOUCHSCREEN_SYNAPTICS_I2C_TD4X00
	tristate "Synaptics DSX2 i2c touchscreen base on bootloader Ver7"
	depends on I2C
	help
	  This enables support for Synaptics DSX2 over I2C based touchscreens.
	  
config TOUCHSCREEN_SYNAPTICS_I2C_TD4X01_A2CORELTE
	tristate "Synaptics DSX2 i2c touchscreen base on bootloader Ver7"
	depends on I2C
	help
	  This enables support for Synaptics DSX2 over I2C based touchscreens.

config TOUCHSCREEN_SYNAPTICS_FB_OPEN_CLOSE
	tristate "Synaptics touchscreen for Project A260 A2 Core"
	help
	  This enables support for Synaptics.
```

## drivers/input/wacom/w9019/Kconfig
```kconfig
#
# Wacom configuration
#

config EPEN_WACOM_W9019_GTANOTE
	tristate "Wacom W9019 penabled i2c touchscreen"
	depends on I2C
	help
	  Say Y here if you have an Wacom G10PM penabled i2c touchscreen
	  connected to your system.

	  If unsure, say N.

	  To compile this driver as a module, choose M here: the
	  module will be called wacom_W9019.

config WACOM_LCD_FREQ_COMPENSATE
	bool "Wacom LCD vsync/hsync frequency compensate rotuine"
	help
	  Say Y here if you have an Wacom lcd freq compensate config

	  If unsure, say N.

	  To compile this driver as a module, choose M here: the
	  module will be called wacom.
```

## drivers/marvell/Kconfig
```kconfig
menuconfig MARVELL_DRIVERS
	bool "Marvell kernel module drivers"
	---help---
	  marvell kernel module drivers

if MARVELL_DRIVERS

config MRVL_WIRELESS
	bool "marvell wireless driver"
	---help---
	This enables the marvell wireless driver for application processor

choice
	depends on MRVL_WIRELESS
	bool "Choose the chip for marvell wireless"
	default MRVL_WL_SD8777

config MRVL_WL_SD8977
	bool "SD8977"
	---help---
	Marvell NIC driver: SD8977 chip SD8977
	
config MRVL_WL_SD8XXX
	bool "SD8977"
	---help---
	Marvell combo driver support: SD8977/ others/ chips

endchoice

config MRVL_WL_BUILD_TYPE
	depends on MRVL_WL_SD8977 || (MRVL_WL_SD8XXX && m)
	tristate "Build type of the driver for MARVELL wireless"
	default m
	---help---
	Choose <m> if you want to build the driver as module;
	<y> to build-in kernel; <n> if you do not want to build.

config MRVL_SKMALLOC
	tristate "Marvell Supper Kmalloc Driver"
	default y
	---help---
	Create skmalloc-xxx like as kmalloc-xxx.
	Driver or module can use these skmalloc caches which will
	be different with kmalloc-xxx.
	Use this method will be helpful for kmalloc issue debugging.

config MRVL_SKMALLOC_WIRELESS_EN
	tristate "marvell wireless driver use skmalloc"
	depends on MRVL_SKMALLOC && MRVL_WIRELESS
	default y
	---help---
	Whether marvell wireless driver uses Supper Kmalloc or not.
	After enable this config, all the kmalloc used in marvell wireless
	driver will use skmalloc-xxx instead of kmalloc-xxx.

source "drivers/marvell/sd8977/Kconfig"

endif
```

## drivers/marvell/sd8977/Kconfig
```kconfig
config MRVL_SDIO_OOB_IRQ
	depends on MRVL_WL_SD8977
	bool "SDIO OOB IRQ"
	---help---
	  SDIO OOB interrupt support
```

## drivers/media/platform/exynos/fimc-is2/hardware/api/Kconfig
```kconfig
config USE_HW_API_COMMON
	bool "Use HW API Common library"
	depends on EXYNOS_FIMC_IS_HARDWARE
	default y
	help
	  Enalbe HW API Common library.

config USE_HOST_FD_LIBRARY
	bool "Use FD library in host"
	depends on EXYNOS_FIMC_IS_HARDWARE
	default n
	help
	  Enalbe SW FD library in host.

config MC_SCALER_V1_20
        bool "Use MC-SCALER v1.20"
	depends on CAMERA_MC_SCALER_VER1_USE
        default n
        help
          use mc-scaler v1.20

config MC_SCALER_V2_10
        bool "Use MC-SCALER v2.10"
	depends on CAMERA_MC_SCALER_VER2_USE
        default n
        help
          use mc-scaler v2.10
```

## drivers/media/platform/exynos/fimc-is2/ischain/fimc-is-v3_11_0/Kconfig
```kconfig
config FIMC_IS_V3_11_0
	bool "Use fimc-is v3.11.0"
	depends on EXYNOS_FIMC_IS
	default n
	help
	  fimc-is version 3.11.0

config CAMERA_MIPI_PHY_SELECT_M0S2
	bool "CSI1 MIPI SELECT"
	depends on FIMC_IS_V3_11_0
	default n
	help
	  This flags enables M0S2 PHY line for CSI1
```

## drivers/media/platform/exynos/fimc-is2/ischain/fimc-is-v5_10_0/Kconfig
```kconfig
config FIMC_IS_V5_10_0
	bool "Use fimc-is v5.10.0"
	depends on EXYNOS_FIMC_IS
	default n
	help
	  fimc-is version 5.10.0
```
